## boards/perfechpitch/christoph_mpw/Kconfig.christoph_mpw
```kconfig
# SPDX-FileCopyrightText: Copyright The Zephyr Project Contributors
# SPDX-License-Identifier: Apache-2.0

config BOARD_CHRISTOPH_MPW
	select SOC_CHRISTOPH_MPW
```

## boards/perfechpitch/christoph_mpw/board.yml
```yaml
# SPDX-FileCopyrightText: Copyright The Zephyr Project Contributors
# SPDX-License-Identifier: Apache-2.0

board:
  name: christoph_mpw
  full_name: Christoph MPW Evaluation Board
  vendor: perfechpitch
  socs:
  - name: christoph_mpw
```

## soc/perfechpitch/christoph_mpw/Kconfig
```kconfig
# SPDX-FileCopyrightText: Copyright The Zephyr Project Contributors
# SPDX-License-Identifier: Apache-2.0

config SOC_CHRISTOPH_MPW
	select ARM
	select CPU_CORTEX_M7
	select CPU_HAS_ARM_MPU
	select CPU_HAS_FPU
	select SOC_EARLY_RESET_HOOK
```

## soc/perfechpitch/christoph_mpw/Kconfig.defconfig
```kconfig
# SPDX-FileCopyrightText: Copyright The Zephyr Project Contributors
# SPDX-License-Identifier: Apache-2.0

if SOC_CHRISTOPH_MPW

config NUM_IRQS
	default 128

config SYS_CLOCK_HW_CYCLES_PER_SEC
	default 1000000000

config BUILD_OUTPUT_BIN
	default y

endif # SOC_CHRISTOPH_MPW
```

## soc/perfechpitch/christoph_mpw/Kconfig.soc
```kconfig
# SPDX-FileCopyrightText: Copyright The Zephyr Project Contributors
# SPDX-License-Identifier: Apache-2.0

config SOC_CHRISTOPH_MPW
	bool

config SOC
	default "christoph_mpw" if SOC_CHRISTOPH_MPW
```
